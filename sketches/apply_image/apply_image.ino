/*
 * This is a minimal example, see extra-examples.cpp for a version
 * with more explantory documentation, example routines, how to
 * hook up your pixels and all of the pixel types that are supported.
 *
 */
#if defined(ARDUINO) 
SYSTEM_MODE(SEMI_AUTOMATIC); 
#endif

#include "application.h"
#include "neopixel.h" // use for Build IDE
// #include "neopixel.h" // use for local build

// your network name also called SSID
char ssid[] = "digitalnihilist";
// your network password
char password[] = "manolis123456";
// your network key Index number (needed only for WEP)
int keyIndex = 0;
String readString;

TCPServer server(80);

void printWifiStatus();

// IMPORTANT: Set pixel COUNT, PIN and TYPE
#define PIXEL_PIN D8
#define PIXEL_COUNT 64
#define PIXEL_TYPE WS2812B

Adafruit_NeoPixel strip = Adafruit_NeoPixel(PIXEL_COUNT, PIXEL_PIN, PIXEL_TYPE);

int colours[10][192] = {{183,169,156,161,143,129,144,125,117,190,181,174,219,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171,184},{31,4,23,43,37,33,18,18,6,2,0,2,32,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17,20},{33,27,39,137,143,147,221,224,231,60,52,55,46,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155,156},{102,81,64,72,59,39,76,59,38,83,65,37,130,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45,37},{81,71,66,83,77,65,52,48,48,92,94,107,120,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178,178},{180,186,198,140,132,131,67,56,40,88,82,82,78,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57,60},{15,27,29,65,59,59,69,53,50,53,45,44,57,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63,72},{50,46,31,103,92,60,133,127,99,103,91,63,90,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64,59},{136,156,161,174,190,227,103,94,99,51,30,23,183,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61,61},{79,82,63,170,149,114,159,158,126,134,145,125,147,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96,79}};

boolean nextImage = false;
boolean fadeOut = true;
int brightness = 190;
int imageId = 0;

void setup()
{
 Serial.begin(115200);
 ///////////////////////
  // LED STRIP RELATED //
  ///////////////////////
  strip.begin();
  
strip.setBrightness(brightness);
  strip.show(); // Initialize all pixels to 'off'

 }

 
void applyColour()
{
  int rowNo = 0;
  
  for(int n=0;n<64;n++)
  { 
    int ledIndex = ((rowNo+1)%2==0)? ((rowNo+1)*8)-n-1+(rowNo*8):n;
    //Serial.println(ledIndex);
    strip.setPixelColor( ledIndex,colours[imageId][n*3],colours[imageId][(n*3)+1],colours[imageId][(n*3)+2]);
   
    strip.show(); 
    if( (n+1)%8==0 ) rowNo++;
    
  }
  

}


void loop()
{

 applyColour();
if(nextImage == false) {
  delay(5000);
}
 nextImage = true;
 Serial.println("Start Fade Out");
 
if(fadeOut)
{
  brightness--;
  
  if(brightness==0)
  {
    
  imageId = (imageId<10)? imageId+1:0;
  fadeOut = false;
  }
  
}
else{
brightness++;
if(brightness==190)
{
  fadeOut = true;
  nextImage = false;
}
}

  Serial.println(brightness);
  strip.setBrightness(brightness);
  delay(2);

}


void printWifiStatus() {
  // print the SSID of the network you're attached to:
  Serial.print("Network Name: ");
  Serial.println(WiFi.SSID());

  // print your WiFi shield's IP address:
  IPAddress ip = WiFi.localIP();
  Serial.print("IP Address: ");
  Serial.println(ip);

  // print the received signal strength:
  long rssi = WiFi.RSSI();
  Serial.print("signal strength (RSSI):");
  Serial.print(rssi);
  Serial.println(" dBm");
}


